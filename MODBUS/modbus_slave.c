#include "modbus_slave.h"
#include "config.h"
#include "timer.h"
#include "bll_main.h"
#include "usart.h"
#include "string.h"
#include "delay.h"

// modbus数组高位
static const unsigned char aucCRCHi[] = {
	0x00, 0xC1, 0x81, 0x40, 0x01, 0xC0, 0x80, 0x41, 0x01, 0xC0, 0x80, 0x41,
	0x00, 0xC1, 0x81, 0x40, 0x01, 0xC0, 0x80, 0x41, 0x00, 0xC1, 0x81, 0x40,
	0x00, 0xC1, 0x81, 0x40, 0x01, 0xC0, 0x80, 0x41, 0x01, 0xC0, 0x80, 0x41,
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	0x00, 0xC1, 0x81, 0x40};
// modbus数组低位
static const unsigned char aucCRCLo[] = {
	0x00, 0xC0, 0xC1, 0x01, 0xC3, 0x03, 0x02, 0xC2, 0xC6, 0x06, 0x07, 0xC7,
	0x05, 0xC5, 0xC4, 0x04, 0xCC, 0x0C, 0x0D, 0xCD, 0x0F, 0xCF, 0xCE, 0x0E,
	0x0A, 0xCA, 0xCB, 0x0B, 0xC9, 0x09, 0x08, 0xC8, 0xD8, 0x18, 0x19, 0xD9,
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	0x41, 0x81, 0x80, 0x40};

static volatile ModBusState MState = MODBUS_IDLE;
// vu16 Reg_4x[MODBUS_REG_COUNT];

static volatile u16 RecCount = 0;
static u8 RecBuff[MODBUS_BUFF_LEN];

void ModBus_SetTimeout(void)
{
	MState = MODBUS_TIMEOUT;
}

void Modbus_ResetToIdle(void)
{
	MState = MODBUS_IDLE;
}

// 计算CRC16
static uint16_t Get_CRC16(unsigned char *pucFrame, uint16_t usLen) // 计算CRC的公式
{
	unsigned char ucCRCHi = 0xFF;
	unsigned char ucCRCLo = 0xFF;
	u16 iIndex = 0;

	while (usLen--)
	{
		iIndex = ucCRCLo ^ *(pucFrame++);
		ucCRCLo = (unsigned char)(ucCRCHi ^ aucCRCHi[iIndex]);
		ucCRCHi = aucCRCLo[iIndex];
	}
	Data8To16(usLen, ucCRCHi, ucCRCLo);
	return usLen;
}

static void Attach_CRC16(unsigned char *pucFrame, uint16_t dataLen) // 用来给某一帧的帧尾加入CRC
{
	unsigned char ucCRCHi = 0xFF;
	unsigned char ucCRCLo = 0xFF;
	uint16_t usLen = dataLen;
	u16 iIndex = 0;
	unsigned char *p = pucFrame;

	while (usLen--)
	{
		iIndex = ucCRCLo ^ *(pucFrame++);
		ucCRCLo = (unsigned char)(ucCRCHi ^ aucCRCHi[iIndex]);
		ucCRCHi = aucCRCLo[iIndex];
	}
#if CRC_ORDER
	p[dataLen + 1] = ucCRCHi;
	p[dataLen] = ucCRCLo;
#else
	p[dataLen] = ucCRCHi;
	p[dataLen + 1] = ucCRCLo;
#endif
}
// count是整个帧在加入CRC之后的字节数，前面count-2个字节是数据，后面2个字节是CRC
static unsigned char Check_CRC16(unsigned char *p, u16 count) // 这里比的是收到的CRC和计算出的CRC
{
	u16 crc = 0;
#if CRC_ORDER
	Data8To16(crc, p[count - 1], p[count - 2]);
#else
	Data8To16(crc, p[count - 2], p[count - 1]); // 把后面两个字节由8位合并为16位，这里是数据发送过来自带的CRC值
#endif
	if (crc == Get_CRC16(p, count - 2)) // 前面count-2个字节是数据，后面两个字节是CRC值
		return 1;
	return 0;
}

void ModBusRecByte(u8 data)
{
	if (MState == MODBUS_IDLE) // 如果从机此时是空闲状态
	{
		RecBuff[0] = data; // 接受第一个字节的数据
		RecCount = 1;
		FUN_RESET_TIMER();		// 把从机定时器TIM6的计数值重置
		FUN_START_TIMER();		// 从机定时器TIM6开始计时
		MState = MODBUS_RECING; // 该状态改成RECING
	}
	else if (MState == MODBUS_RECING)
	{
		RecBuff[RecCount++] = data; // RECING状态下就一直接受数据，最大能够一次性接受1024个字节
		if (RecCount >= MODBUS_BUFF_LEN)
			RecCount = 0;
		FUN_RESET_TIMER();
	}
}

static void Handle_0x03(void);
static void Handle_0x06(void);
static void Handle_0x10(void);
static void Handle_0x64(void);
static void SendError(u8 fun, ModBusFailCode_Type errcode);

extern void BLL_Update(void);
void ModBus_Pool(void)
{
	ModBusFailCode_Type errcode = MODBUS_OK;
	if (MState == MODBUS_TIMEOUT)
	{
		MState = MODBUS_HANDLING;
		if (RecBuff[0] != MODBUS_ADDR) // 第一个字节是这个MODBUS从机的地址
		{
			//			errcode = MODBUS_ERR_Addr;
			//			goto errorsend;
			MState = MODBUS_IDLE;
			return;
		}
#if SKIP_CRC == 0
		if (!Check_CRC16(RecBuff, RecCount))
		{
			// errcode = MODBUS_ERR_CRC;
			// goto errorsend;
			MState = MODBUS_IDLE;
			return;
		}
#endif
		FUN_485_DIR(DIR_485_WRITEONLY); // nop不进行任何操作
		switch (RecBuff[1])				// 第二个字节是要进行的操作
		{
		case 0x03:
			Handle_0x03();
			break;
		case 0x06:
			Handle_0x06();
			break;
		case 0x10:
			Handle_0x10();
			break;
		case 0x64:
			Handle_0x64();
			break;
		}
		goto end0;
	errorsend:
		SendError(RecBuff[1], errcode);
	end0:
		MState = MODBUS_SENDING;
		FUN_485_DIR(DIR_485_READONLY);
	}
}

__weak u8 ExecuteCommand_Handler(u16 *cmd)
{
	return 0;
}

#include "gpio.h"
#include "modbus_save_data.h"

__weak void UpdateRawValue_Handler(u8 subaddr, u8 len)
{

	u16 *p_reg = (u16 *)&RAW_REG + subaddr; // 用RAW_REG当成PC2~PC9和PD6,PD0,PD1总共十个端口的数据寄存器
	if (subaddr >= 1 && subaddr <= 10)		// 更新一下对应读取IO口的值
	{
		for (u8 i = 0; i < len; i++)
		{
			p_reg[i] = Read_Switch(subaddr + i);
		}
	}
}

static void Handle_0x03(void) // 主机发命令要读这个从机的数据，从机把自己PC2~PC9,PD6,PD0,PD1数据发送到DMA缓存区中
{
	u16 base_addr, len;
	Data8To16(base_addr, RecBuff[2], RecBuff[3]); //
	Data8To16(len, RecBuff[4], RecBuff[5]);		  //
	RecBuff[2] = 2 * len;
	u8 region = base_addr / 100;
	u8 subaddr = base_addr % 100;
	if (!ValidateRegRange(region, subaddr + len))
	{
		SendError(0x03, MODBUS_ERR_Reg);
		return;
	}
	if (region == 3)								   // 如果对应区域是3，可以看作读寄存器
		UpdateRawValue_Handler(subaddr, len);		   // 更新一下传感器读到的数据
	u16 *p_reg = (u16 *)Reg_Regions[region] + subaddr; // 区域起始地址加偏移
	u8 *p_buff = &RecBuff[3];						   // 0是从机地址，1是要进行的操作，2本来是用来发送base_addr来确定读的寄存器地址的，
													   // 后面被用来存放读取的字节数了，所以从3开始，把要读的数据放进RECBUF这个缓冲区
	memcpy(p_buff, p_reg, 2 * len);
	Attach_CRC16(RecBuff, 3 + RecBuff[2]);	// 放完之后加上CRC校验值
	FUN_SEND_DATA(RecBuff, 5 + RecBuff[2]); // 再发送这个读到的数据
}

static void Handle_0x06(void) //
{
	u16 base_addr, value;
	Data8To16(base_addr, RecBuff[2], RecBuff[3]);
	Data8To16(value, RecBuff[4], RecBuff[5]); // 这次45放入值value
	u8 region = base_addr / 100;
	u8 subaddr = base_addr % 100;
	if (!ValidateRegRange(region, subaddr))
	{
		SendError(0x06, MODBUS_ERR_Reg);
		return;
	}
	u16 *p_reg = (u16 *)Reg_Regions[region] + subaddr;
	if (region == 5)
	{
		u8 rt = ExecuteCommand_Handler((u16 *)Reg_Regions[5]); // 这个函数直接return 0
		if (rt)
		{
			SendError(0x06, (ModBusFailCode_Type)rt);
			return;
		}
	}
	*p_reg = value;			   // 把16位value写入指定的地址
	FUN_SEND_DATA(RecBuff, 8); // 从机地址0+操作1+寄存器地址23+写入值45+CRC校验67，因为0x06主机发过来的时候就是带有CRC的帧，这里什么值都没变过，直接发回去就行了
}

static void Handle_0x10(void) // 对一个地址连续写入数据
{
	u16 base_addr, len, len_byte;
	Data8To16(base_addr, RecBuff[2], RecBuff[3]);
	Data8To16(len, RecBuff[4], RecBuff[5]);
	len_byte = RecBuff[6]; // 这里表示写多少个字节，对一个地址连续写入
	u8 region = base_addr / 100;
	u8 subaddr = base_addr % 100;
	if (!ValidateRegRange(region, subaddr + len))
	{
		SendError(0x10, MODBUS_ERR_Reg);
		return;
	}
	u16 *p_reg = (u16 *)Reg_Regions[region] + subaddr;
	u8 *p_buff = &RecBuff[7];
	memcpy(p_reg, p_buff, len_byte);
	if (region == 5)
	{
		u8 rt = ExecuteCommand_Handler((u16 *)Reg_Regions[5]);
		if (rt)
		{
			SendError(0x10, (ModBusFailCode_Type)rt);
			return;
		}
	}
	Attach_CRC16(RecBuff, 6);
	FUN_SEND_DATA(RecBuff, 8);
}

extern u8 IsJumpIAP;
static void Handle_0x64(void)
{
	FUN_SEND_DATA(RecBuff, 4);
	delay_ms(200);
	// BLL_Update();
	IsJumpIAP = 1;
}

static void SendError(u8 fun, ModBusFailCode_Type errcode)
{
	u8 err[5] = {MODBUS_ADDR, fun | 0x80, errcode};
	Attach_CRC16(err, 3);
	FUN_SEND_DATA(err, 5);
}
